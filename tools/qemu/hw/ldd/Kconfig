## tools/qemu/hw/ldd/Kconfig
```kconfig
config LDD_IO
    bool
    default y
    depends on ISA_BUS

config LDD_USB
    bool
    default y
    depends on USB

config LDD_PCIE
    bool
    default y
    depends on PCI_EXPRESS
```
